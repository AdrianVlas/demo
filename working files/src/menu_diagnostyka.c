#include "header.h"

/*****************************************************/
//Формуємо екран відображення діагностики
/*****************************************************/
void make_ekran_diagnostyka(unsigned int volatile *diagnostyka_tmp)
{
#define NUMBER_ROW_FOR_NO_ERRORS 2
  
  unsigned int position_temp = current_ekran.index_position;
  const unsigned char name_string[MAX_NAMBER_LANGUAGE][NUMBER_ROW_FOR_NO_ERRORS + MAX_ROW_FOR_DIAGNOSTYKA][MAX_COL_LCD] = 
  {
    {
      "      Нет       ",
      "     ошибок     ",
      " Ош.I2C         ",
      " Ош.настроек    ",
      " Настроек нет   ",
      " Ош.зап.настр.  ",
      " Ош.контр.настр.",
      " Ош.типа настр. ",
      " Ош.юстирования ",
      " Юстирования нет",
      " Ош.зап.юстир.  ",
      " Ош.контр.юстир.",
      " Ош.юстир.набора",
      " Ош.воcст.тр.св ",
      " Ош.воcст.с.вых ",
      "Инф.вых./св.нет ",
      " Ош.зап.вых./св.",
      "  Ош.триг.инф.  ",
      "  Триг.инф.нет  ",
      "Ош.зап.триг.инф.",
      "Ош.контр.триг.и.",
      " Ош.инф.ан.рег. ",
      " Инф.ан.рег.нет ",
      "Ош.зап.и.ан.рег.",
      "Ош.контр.ан.рег.",
      " Ош.инф.д.рег.  ",
      " Инф.д.рег.нет  ",
      " Ош.зап.и.д.рег.",
      " Ош.контр.д.рег.",
      "Ош.инф.рег.пр.с.",
      "Инф.рег.пр.с.нет",
      "Ош.зап.и.р.пр.с.",
      "Ош.контр.р.пр.с.",
      " Ош.инф.сч.рес. ",
      " Инф.сч.рес.нет ",
      " Ош.зап.сч.рес. ",
      "Ош.контр.сч.рес.",
      " Ош.к.с.энергий ",
      "  Энергий нет   ",
      " Ош.зап.энергий ",
      " Батарея разряж.",
      "Осцилятор остан.",
      "Отказ Осцилятора",
      " Ост.обновл.RTC ",
      " Не уст.поля RTC",
      " Тест GND АЦП1  ",
      " Тест VREF АЦП1 ",
      " Тест VDD АЦП1  ",
      "Тест GND АЦП1 гр",
      "Тест VREF АЦП1гр",
      "Тест VDD АЦП1 гр",
      " Тест GND АЦП2  ",
      " Тест VREF АЦП2 ",
      " Тест VDD АЦП2  ",
      "Тест GND АЦП2 гр",
      "Тест VREF АЦП2гр",
      "Тест VDD АЦП2 гр",
      "Переп.буф.ц.осц.",
      " Ош.вых.реле    ",
      "Ан.рег.вр.занят.",
      " Пер.буф.aн.рег.",
      "Неопр.ош.ан.рег.",
      "Потеря д.ан.рег.",
      " Д.рег.вр.занят.",
      " Неопр.ош.д.рег.",
      " Потеря д.д.рег.",
      "Переп.буф.пр.ош.",
      " Потеря д.пр.ош.",
      " Старт устр.    ",
      " Рестарт устр.  ",
      " Останов.устр.  ",
      " Пропад.питания ",
      " Отказ ЖКИ      ",
      " Ош.SPI_DF      ",
      " Ош.внешней SRAM",
      " Ош.внутр.FLASH ",
      " Ош.выб.гр.уст. ",
      " Пот.д.энергии  ",
      " Ошибка 77      ",
      " Ошибка 78      ",
      " Ошибка 79      ",
      " Ошибка 80      ",
      " Ошибка 81      ",
      " Ошибка 82      ",
      " Ошибка 83      ",
      " Ошибка 84      ",
      " Ошибка 85      ",
      " Ошибка 86      ",
      " Ошибка 87      ",
      " Ошибка 88      "
    },
    {
      "     Немає      ",
      "    помилок     ",
      " Пом.I2C        ",
      " Пом.налаштувань",
      "Налаштувань нема",
      " Пом.зап.налашт.",
      "Пом.контр.налашт",
      " Пом.типу налашт",
      " Пом.юстування  ",
      " Юстування нема ",
      " Пом.зап.юст.   ",
      " Пом.контр.юст. ",
      " Пом.юст.набору ",
      " Пом.відн.тр.св.",
      " Пом.відн.с.вих.",
      "Інф.вих./св.нема",
      "Пом.зап.вих./св.",
      " Пом.триґ.інф.  ",
      " Триґ.інф.нема  ",
      " Пом.зап.триґ.і.",
      "Пом.контр.триґ.і",
      " Пом.інф.ан.р.  ",
      " Інф.ан.р.нема  ",
      " Пом.зап.і.ан.р.",
      " Пом.контр.ан.р.",
      " Пом.інф.д.р.   ",
      " Інф.д.р.нема   ",
      " Пом.зап.і.д.р. ",
      " Пом.контр.д.р. ",
      " Пом.інф.р.пр.п.",
      " Інф.р.пр.п.нема",
      "Пом.зап.і.р.пр.п",
      "Пом.контр.р.пр.п",
      " Пом.інф.ліч.р. ",
      " Інф.ліч.р.нема ",
      " Пом.зап.ліч.р. ",
      "Пом.контр.ліч.р.",
      " Пом.к.с.енергій",
      "  Енергій нема  ",
      " Пом.зап.енергій",
      "Батарея разрядж.",
      " Осцилятор зуп. ",
      " Відм.Осцилятора",
      " Зуп.обновл.RTC ",
      " Не вст.поля RTC",
      " Тест GND АЦП1  ",
      " Тест VREF АЦП1 ",
      " Тест VDD АЦП1  ",
      "Тест GND АЦП1 гр",
      "Тест VREF АЦП1гр",
      "Тест VDD АЦП1 гр",
      " Тест GND АЦП2  ",
      " Тест VREF АЦП2 ",
      " Тест VDD АЦП2  ",
      "Тест GND АЦП2 гр",
      "Тест VREF АЦП2гр",
      "Тест VDD АЦП2 гр",
      "Переп.буф.ц.осц.",
      " Пом.вих.реле   ",
      "Ан.р.тимч.зайнят",
      " Переп.буф.aн.р.",
      "Невизн.пом.ан.р.",
      "Втрата д.ан.р.  ",
      "Д.р.тимч.зайнят.",
      " Невизн.пом.д.р.",
      " Втрата д.д.р.  ",
      "Переп.буф.р.пр.п",
      " Втрата д.р.пр.п",
      " Старт пристр.  ",
      " Рестарт пристр.",
      " Зуп.пристр.    ",
      " Пропад.живлення",
      " Відмова РКІ    ",
      " Пом.SPI_DF     ",
      " Пом.зовн.SRAM  ",
      " Пом.внутр.FLASH",
      " Пом.виб.гр.уст.",
      " Втр.д.енергії  ",
      " Помилка 77     ",
      " Помилка 78     ",
      " Помилка 79     ",
      " Помилка 80     ",
      " Помилка 81     ",
      " Помилка 82     ",
      " Помилка 83     ",
      " Помилка 84     ",
      " Помилка 85     ",
      " Помилка 86     ",
      " Помилка 87     ",
      " Помилка 88     "
    },
    {
      "       No       ",
      "     errors     ",
      " I2C Err.       ",
      " Settings Err.  ",
      " No settings    ",
      " Sett.W.Err.    ",
      " Sett.Ctrl.Err. ",
      " Sett.Type Err. ",
      " Adjust Err.    ",
      " No adjust      ",
      " Adjust W.Err.  ",
      "Adjust Ctrl.Err.",
      " Adjust-Set Err.",
      "Tr.LED Rest Err.",
      "Sign DO Rest Err",
      " No DO/LED Inf. ",
      " DO/LED W Err.  ",
      "  Ош.триг.инф.  ",
      "  Триг.инф.нет  ",
      "Ош.зап.триг.инф.",
      "Ош.контр.триг.и.",
      " An.Rec.Inf.Err.",
      " No An.Rec.Inf. ",
      "An.Rec.Inf.W.Err",
      "An.Rec.Ctrl.Err.",
      " D.Rec.Inf.Err. ",
      " No D.Rec.Inf.  ",
      "Inf.D.Rec.W.Err.",
      " D.Rec.Ctrl.Err.",
      " PER Inf.Err.   ",
      " No Inf.of PER  ",
      "Inf.W.Err.of PER",
      " PER Ctrl.Err.  ",
      " Res.C.Inf.Err. ",
      " No Res.C.Inf.  ",
      "Inf.Res.C.W.Err.",
      " Res.C.Ctrl.Err.",
      " Ош.к.с.энергий ",
      "  Энергий нет   ",
      " Ош.зап.энергий ",
      " RTC:Battery low",
      " RTC:Osc.stop   ",
      " RTC:Osc.fail   ",
      " RTC:Halt update",
      "RTC:No def.sett.",
      " ADC1:GND fail  ",
      " ADC1:VREF fail ",
      " ADC1:VDD fail  ",
      "ADC1:GND Test R.",
      "ADC1:VREF Test R",
      "ADC1:VDD Test R.",
      " ADC2:GND fail  ",
      " ADC2:VREF fail ",
      " ADC2:VDD fail  ",
      "ADC2:GND Test R.",
      "ADC2:VREF Test R",
      "ADC2:VDD Test R.",
      "Переп.буф.ц.осц.",
      " DO Ctrl.Err.   ",
      " An.Rec.busy    ",
      " An.Rec.buff.OVF",
      "Undef.An.Rec.Err",
      "An.Rec.Data lost",
      " D.Rec.busy     ",
      "Undef.D.Rec.Err.",
      " D.Rec.Data lost",
      "OVF of PER buff.",
      " PER Data lost  ",
      " Device Start   ",
      " Device Restart ",
      " Device Stop    ",
      " Пропад.питания ",
      " LCD Fail       ",
      " DF SPI Err.    ",
      " Ext.SRAM Err.  ",
      " Int.FLASH Err. ",
      " Ош.выб.гр.уст. ",
      " Пот.д.энергии  ",
      " Error 77       ",
      " Error 78       ",
      " Error 79       ",
      " Error 80       ",
      " Error 81       ",
      " Error 82       ",
      " Error 83       ",
      " Error 84       ",
      " Error 85       ",
      " Error 86       ",
      " Error 87       ",
      " Error 88       "
    },
    {
      "      Кате      ",
      "      жок       ",
      " Ош.I2C         ",
      " Ош.настроек    ",
      " Настроек нет   ",
      " Ош.зап.настр.  ",
      " Ош.контр.настр.",
      " Ош.типа настр. ",
      " Ош.юстирования ",
      " Юстирования нет",
      " Ош.зап.юстир.  ",
      " Ош.контр.юстир.",
      " Ош.юстир.набора",
      " Ош.воcст.тр.св ",
      " Ош.воcст.с.вых ",
      "Инф.вых./св.нет ",
      " Ош.зап.вых./св.",
      "  Ош.триг.инф.  ",
      "  Триг.инф.нет  ",
      "Ош.зап.триг.инф.",
      "Ош.контр.триг.и.",
      " Ош.инф.ан.рег. ",
      " Инф.ан.рег.нет ",
      "Ош.зап.и.ан.рег.",
      "Ош.контр.ан.рег.",
      " Ош.инф.д.рег.  ",
      " Инф.д.рег.нет  ",
      " Ош.зап.и.д.рег.",
      " Ош.контр.д.рег.",
      "Ош.инф.рег.пр.с.",
      "Инф.рег.пр.с.нет",
      "Ош.зап.и.р.пр.с.",
      "Ош.контр.р.пр.с.",
      " Ош.инф.сч.рес. ",
      " Инф.сч.рес.нет ",
      " Ош.зап.сч.рес. ",
      "Ош.контр.сч.рес.",
      " Ош.к.с.энергий ",
      "  Энергий нет   ",
      " Ош.зап.энергий ",
      " Батарея разряж.",
      "Осцилятор остан.",
      "Отказ Осцилятора",
      " Ост.обновл.RTC ",
      " Не уст.поля RTC",
      " Тест GND АЦП1  ",
      " Тест VREF АЦП1 ",
      " Тест VDD АЦП1  ",
      " Тест GND АЦП1гр",
      "Тест VREF АЦП1гр",
      "Тест VDD АЦП1 гр",
      " Тест GND АЦП2  ",
      " Тест VREF АЦП2 ",
      " Тест VDD АЦП2  ",
      " Тест GND АЦП2гр",
      "Тест VREF АЦП2гр",
      "Тест VDD АЦП2 гр",
      "Переп.буф.ц.осц.",
      " Ош.вых.реле    ",
      "Ан.рег.вр.занят.",
      " Пер.буф.aн.рег.",
      "Неопр.ош.ан.рег.",
      "Потеря д.ан.рег.",
      " Д.рег.вр.занят.",
      " Неопр.ош.д.рег.",
      " Потеря д.д.рег.",
      "Переп.буф.пр.ош.",
      " Потеря д.пр.ош.",
      " Старт устр.    ",
      " Рестарт устр.  ",
      " Останов.устр.  ",
      " Пропад.питания ",
      " Отказ ЖКИ      ",
      " Ош.SPI_DF      ",
      " Ош.внешней SRAM",
      " Ош.внутр.FLASH ",
      " Ош.выб.гр.уст. ",
      " Пот.д.энергии  ",
      " Ошибка 77      ",
      " Ошибка 78      ",
      " Ошибка 79      ",
      " Ошибка 80      ",
      " Ошибка 81      ",
      " Ошибка 82      ",
      " Ошибка 83      ",
      " Ошибка 84      ",
      " Ошибка 85      ",
      " Ошибка 86      ",
      " Ошибка 87      ",
      " Ошибка 88      "
    }
  };

  int index_language = index_language_in_array(current_settings.language);
  
    
  if (
      (*(diagnostyka_tmp + 0) == 0) &&
      (*(diagnostyka_tmp + 1) == 0) &&
      (*(diagnostyka_tmp + 2) == 0) 
     )
  {
    //Це означає, що ніякої помилки не зафіксовано
     
    //Текучу позицію в сипску переводимо на сам початок
    current_ekran.index_position = 0;
    position_in_current_level_menu[EKRAN_DIAGNOSTYKA] = 0;

    //Копіюємо  рядки у робочий екран
    for (unsigned int i=0; i< MAX_ROW_LCD; i++)
    {
      //Копіюємо в робочий екран інформацію, що нічого не відранжовано
      if (i < 2)
        for (unsigned int j = 0; j<MAX_COL_LCD; j++) working_ekran[i][j] = name_string[index_language][i][j];
      else
        for (unsigned int j = 0; j<MAX_COL_LCD; j++) working_ekran[i][j] = ' ';
    }
    //Курсор не видимий
    current_ekran.cursor_on = 0;
  }
  else
  {
    /************************************************************/
    //Формуємо список із помилок які реально присутні
    /************************************************************/
    unsigned char name_string_tmp[MAX_ROW_FOR_DIAGNOSTYKA][MAX_COL_LCD];

    for(unsigned int index_1 = 0; index_1 < MAX_ROW_FOR_DIAGNOSTYKA; index_1++)
    {
      for(unsigned int index_2 = 0; index_2 < MAX_COL_LCD; index_2++)
        name_string_tmp[index_1][index_2] = name_string[index_language][NUMBER_ROW_FOR_NO_ERRORS + index_1][index_2];
    }

    unsigned int index_of_ekran;
    unsigned int i = 0, offset = 0;

    while ((i + offset) < MAX_ROW_FOR_DIAGNOSTYKA)
    {
      if (_CHECK_SET_BIT(diagnostyka_tmp, (i + offset)) == 0)
      {
        for (unsigned int j = i; j < (MAX_ROW_FOR_DIAGNOSTYKA - offset); j++)
        {
          if ((j + 1) < (MAX_ROW_FOR_DIAGNOSTYKA - offset))
          {
            for (unsigned int k = 0; k<MAX_COL_LCD; k++)
              name_string_tmp[j][k] = name_string_tmp[j + 1][k];
          }
          else 
          {
            for (unsigned int k = 0; k<MAX_COL_LCD; k++)
              name_string_tmp[j][k] = ' ';
          }
        }
        if (current_ekran.index_position >= ((int)(i + offset))) position_temp--;
        offset++;
      }
      else i++;
    }
    /************************************************************/

    
    index_of_ekran = (position_temp >> POWER_MAX_ROW_LCD) << POWER_MAX_ROW_LCD;
      
    //Копіюємо  рядки у робочий екран
    for (i=0; i< MAX_ROW_LCD; i++)
    {
      //Наступні рядки треба перевірити, чи їх требе відображати у текучій коффігурації
      if (index_of_ekran < MAX_ROW_FOR_DIAGNOSTYKA)
        for (unsigned int j = 0; j<MAX_COL_LCD; j++) working_ekran[i][j] = name_string_tmp[index_of_ekran][j];
      else
        for (unsigned int j = 0; j<MAX_COL_LCD; j++) working_ekran[i][j] = ' ';

      index_of_ekran++;
    }

    //Курсор видимий
    current_ekran.cursor_on = 1;
  }

  //Курсор по горизонталі відображається на першій позиції
  current_ekran.position_cursor_x = 0;
  //Відображення курору по вертикалі
  current_ekran.position_cursor_y = position_temp & (MAX_ROW_LCD - 1);
  //Курсор не мигає
  current_ekran.cursor_blinking_on = 0;

  //Обновити повністю весь екран
  current_ekran.current_action = ACTION_WITH_CARRENT_EKRANE_FULL_UPDATE;
  
#undef NUMBER_ROW_FOR_NO_ERRORS
}
/*****************************************************/

/*****************************************************/
//
/*****************************************************/
/*****************************************************/
